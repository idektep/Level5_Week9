#include "U8glib.h"
/*-----------------------------------------------*/
U8GLIB_SSD1306_128X64 u8g(U8G_I2C_OPT_DEV_0 | U8G_I2C_OPT_NO_ACK | U8G_I2C_OPT_FAST); // Fast I2C / TWI

const int NUM_ITEMS = 3; // number of items in the list and also the number of screenshots and screenshots with QR codes (other screens)
const int MAX_ITEM_LENGTH = 20; // maximum characters for the item name

const unsigned char upir_logo [] PROGMEM = 
{  
B00010101,  B11010111,
B00010101,  B01000101,
B00010101,  B10010110,
B00011001,  B00010101     
};

const unsigned char bitmap_icon_Level1 [] PROGMEM = 
{
	0x00, 0x00, 0x00, 0x00, 0x03, 0xc0, 0x2e, 0x70, 0x38, 0x18, 0x38, 0x08, 0x38, 0x0c, 0x00, 0x04, 
	0x20, 0x00, 0x30, 0x1c, 0x10, 0x1c, 0x18, 0x1c, 0x0e, 0x74, 0x03, 0xc0, 0x00, 0x00, 0x00, 0x00
};

const unsigned char bitmap_icon_Level4 [] PROGMEM = 
{
	0x00, 0x00, 0x00, 0x00, 0x03, 0xc0, 0x2e, 0x70, 0x38, 0x18, 0x38, 0x08, 0x38, 0x0c, 0x00, 0x04, 
	0x20, 0x00, 0x30, 0x1c, 0x10, 0x1c, 0x18, 0x1c, 0x0e, 0x74, 0x03, 0xc0, 0x00, 0x00, 0x00, 0x00
};

const unsigned char bitmap_icon_Reset [] PROGMEM = 
{
	0x00, 0x00, 0x00, 0x00, 0x03, 0xc0, 0x2e, 0x70, 0x38, 0x18, 0x38, 0x08, 0x38, 0x0c, 0x00, 0x04, 
	0x20, 0x00, 0x30, 0x1c, 0x10, 0x1c, 0x18, 0x1c, 0x0e, 0x74, 0x03, 0xc0, 0x00, 0x00, 0x00, 0x00
};

const unsigned char* bitmap_icons[NUM_ITEMS] = 
{
  bitmap_icon_Level1,
  bitmap_icon_Level4,
  bitmap_icon_Reset
};

const unsigned char bitmap_screenshot_Level1 [] PROGMEM = 
{
  0x00, 0x00, 0x00, 0x00, 0x00, 0x00, 0x00, 0x00, 0x00, 0x00, 0x00, 0x00, 0x00, 0x00, 0x00, 0x00, 
	0x00, 0x00, 0x00, 0x00, 0x00, 0x00, 0x00, 0x00, 0x00, 0x00, 0x00, 0x00, 0x00, 0x00, 0x00, 0x00, 
	0x00, 0x00, 0x00, 0x00, 0x00, 0x00, 0x00, 0x00, 0x00, 0x00, 0x00, 0x00, 0x00, 0x00, 0x00, 0x00, 
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	0x00, 0x00, 0x00, 0x00, 0x00, 0x00, 0x00, 0x00, 0x00, 0x00, 0x00, 0x00, 0x00, 0x00, 0x00, 0x00
};

const unsigned char bitmap_screenshot_Level4 [] PROGMEM = 
{
  0x00, 0x00, 0x00, 0x00, 0x00, 0x00, 0x00, 0x00, 0x00, 0x00, 0x00, 0x00, 0x00, 0x00, 0x00, 0x00, 
	0x00, 0x00, 0x00, 0x00, 0x00, 0x00, 0x00, 0x00, 0x00, 0x00, 0x00, 0x00, 0x00, 0x00, 0x00, 0x00, 
	0x00, 0x00, 0x00, 0x00, 0x00, 0x00, 0x00, 0x00, 0x00, 0x00, 0x00, 0x00, 0x00, 0x00, 0x00, 0x00, 
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	0x00, 0x00, 0x00, 0x00, 0x00, 0x00, 0x00, 0x00, 0x00, 0x00, 0x00, 0x00, 0x00, 0x00, 0x00, 0x00
};

const unsigned char bitmap_screenshot_Reset [] PROGMEM = 
{
  0x00, 0x00, 0x00, 0x00, 0x00, 0x00, 0x00, 0x00, 0x00, 0x00, 0x00, 0x00, 0x00, 0x00, 0x00, 0x00, 
	0x00, 0x00, 0x00, 0x00, 0x00, 0x00, 0x00, 0x00, 0x00, 0x00, 0x00, 0x00, 0x00, 0x00, 0x00, 0x00, 
	0x00, 0x00, 0x00, 0x00, 0x00, 0x00, 0x00, 0x00, 0x00, 0x00, 0x00, 0x00, 0x00, 0x00, 0x00, 0x00, 
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	0x00, 0x00, 0x00, 0x00, 0x00, 0x00, 0x00, 0x00, 0x00, 0x00, 0x00, 0x00, 0x00, 0x00, 0x00, 0x00
};

const unsigned char* bitmap_screenshots[NUM_ITEMS] = 
{
  bitmap_screenshot_Level1,
  bitmap_screenshot_Level4,
  bitmap_screenshot_Reset
};

// 'scrollbar_background', 8x64px
const unsigned char bitmap_scrollbar_background [] PROGMEM = 
{
  0x00, 0x02, 0x00, 0x02, 0x00, 0x02, 0x00, 0x02, 0x00, 0x02, 0x00, 0x02, 0x00, 0x02, 0x00, 0x02, 
  0x00, 0x02, 0x00, 0x02, 0x00, 0x02, 0x00, 0x02, 0x00, 0x02, 0x00, 0x02, 0x00, 0x02, 0x00, 0x02, 
  0x00, 0x02, 0x00, 0x02, 0x00, 0x02, 0x00, 0x02, 0x00, 0x02, 0x00, 0x02, 0x00, 0x02, 0x00, 0x02, 
  0x00, 0x02, 0x00, 0x02, 0x00, 0x02, 0x00, 0x02, 0x00, 0x02, 0x00, 0x02, 0x00, 0x02, 0x00, 0x00
};

// 'item_sel_outline', 128x21px
const unsigned char bitmap_item_sel_outline [] PROGMEM = 
{
  0x1f, 0xff, 0xff, 0xff, 0xff, 0xff, 0xff, 0xff, 0xff, 0xff, 0xff, 0xff, 0xff, 0xff, 0xff, 0xc0, 
  0x20, 0x00, 0x00, 0x00, 0x00, 0x00, 0x00, 0x00, 0x00, 0x00, 0x00, 0x00, 0x00, 0x00, 0x00, 0x20, 
  0x40, 0x00, 0x00, 0x00, 0x00, 0x00, 0x00, 0x00, 0x00, 0x00, 0x00, 0x00, 0x00, 0x00, 0x00, 0x30, 
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  0x1f, 0xff, 0xff, 0xff, 0xff, 0xff, 0xff, 0xff, 0xff, 0xff, 0xff, 0xff, 0xff, 0xff, 0xff, 0xc0
};
// ------------------ end generated bitmaps from image2cpp ---------------------------------
char menu_items [NUM_ITEMS] [MAX_ITEM_LENGTH] = {  // array with item names
  { "Level1" }, //case0
  { "Level4" }, //case0
  { "Reset" }, //case0
 };
// note - when changing the order of items above, make sure the other arrays referencing bitmaps
// also have the same order, for example array "bitmap_icons" for icons, and other arrays for screenshots and QR codes

#define BUTTON_UP_PIN 50 // pin for UP button 
#define BUTTON_SELECT_PIN 51 // pin for SELECT button
#define BUTTON_DOWN_PIN 53 // pin for DOWN button

int button_up_clicked = 0; // only perform action when button is clicked, and wait until another press
int button_select_clicked = 0; // same as above
int button_down_clicked = 0; // same as above

int item_selected = 0; // which item in the menu is selected

int item_sel_previous; // previous item - used in the menu screen to draw the item before the selected one
int item_sel_next; // next item - used in the menu screen to draw next item after the selected one

int current_screen = 0;   // 0 = menu, 1 = screenshot, 2 = qr

int OldItem = 0;

void Oled1306Setup()
{
  pinMode(BUTTON_UP_PIN, INPUT_PULLUP); // up button
  pinMode(BUTTON_SELECT_PIN, INPUT_PULLUP); // select button
  pinMode(BUTTON_DOWN_PIN, INPUT_PULLUP); // down button
/*-----------------------------------------------*///Oled
  u8g.setFont(u8g_font_tpssb);
  u8g.setColorIndex(1);
}

void OLED() {
  if (current_screen == 0) 
  { // MENU SCREEN
      // up and down buttons only work for the menu screen
      if ((digitalRead(BUTTON_UP_PIN) == LOW) && (button_up_clicked == 0)) 
      { // up button clicked - jump to previous menu item
        item_selected = item_selected - 1; // select previous item
        button_up_clicked = 1; // set button to clicked to only perform the action once
        if (item_selected < 0) 
        { // if first item was selected, jump to last item
          item_selected = NUM_ITEMS-1;
        }
      }
      else if ((digitalRead(BUTTON_DOWN_PIN) == LOW) && (button_down_clicked == 0)) 
      { // down button clicked - jump to next menu item
        item_selected = item_selected + 1; // select next item
        button_down_clicked = 1; // set button to clicked to only perform the action once
        if (item_selected >= NUM_ITEMS) 
        { // last item was selected, jump to first menu item
          item_selected = 0;
        }
      } 
      if ((digitalRead(BUTTON_UP_PIN) == HIGH) && (button_up_clicked == 1)) 
      { // unclick 
        button_up_clicked = 0;
      }
      if ((digitalRead(BUTTON_DOWN_PIN) == HIGH) && (button_down_clicked == 1)) 
      { // unclick
        button_down_clicked = 0;
      }
  }
  if ((digitalRead(BUTTON_SELECT_PIN) == LOW) && (button_select_clicked == 0)) 
  { // select button clicked, jump between screens
     button_select_clicked = 1; // set button to clicked to only perform the action once
     if (current_screen == 0) 
     {
       current_screen = 1;
     } // menu items screen --> screenshots screen
     else 
     {
       current_screen = 0;
     } // qr codes screen --> menu items screen
  }
  if ((digitalRead(BUTTON_SELECT_PIN) == HIGH) && (button_select_clicked == 1)) 
  { // unclick 
    button_select_clicked = 0;
  }
  // set correct values for the previous and next items
  item_sel_previous = item_selected - 1;
  if (item_sel_previous < 0) 
  {
    item_sel_previous = NUM_ITEMS - 1;
  } // previous item would be below first = make it the last
  item_sel_next = item_selected + 1;  
  if (item_sel_next >= NUM_ITEMS) 
  {
    item_sel_next = 0;
  } // next item would be after last = make it the first

  u8g.firstPage(); // required for page drawing mode for u8g library
  do {
    if (current_screen == 0) 
    { // MENU SCREEN

      // selected item background
      u8g.drawBitmapP(0, 22, 128/8, 21, bitmap_item_sel_outline);

      // draw previous item as icon + label
      u8g.setFont(u8g_font_7x14);
      u8g.drawStr(25, 15, menu_items[item_sel_previous]); 
      u8g.drawBitmapP( 4, 2, 16/8, 16, bitmap_icons[item_sel_previous]);          

      // draw selected item as icon + label in bold font
      u8g.setFont(u8g_font_7x14B);    
      u8g.drawStr(25, 15+20+2, menu_items[item_selected]);   
      u8g.drawBitmapP( 4, 24, 16/8, 16, bitmap_icons[item_selected]);     

      // draw next item as icon + label
      u8g.setFont(u8g_font_7x14);     
      u8g.drawStr(25, 15+20+20+2+2, menu_items[item_sel_next]);   
      u8g.drawBitmapP( 4, 46, 16/8, 16, bitmap_icons[item_sel_next]);  

      // draw scrollbar background
      u8g.drawBitmapP(128-8, 0, 8/8, 64, bitmap_scrollbar_background);

      // draw scrollbar handle
      u8g.drawBox(125, 64/NUM_ITEMS * item_selected, 3, 64/NUM_ITEMS); 

      // draw upir logo
      u8g.drawBitmapP(128-16-4, 64-4, 16/8, 4, upir_logo);               
    } 
    else if (current_screen == 1) 
    { // SCREENSHOTS SCREEN
        u8g.drawBitmapP( 0, 0, 128/8, 64, bitmap_screenshots[item_selected]); // draw screenshot
        if(OldItem != item_selected)
        {
          SentData(item_selected);
        }
        OldItem = item_selected;
    }
  } while ( u8g.nextPage() ); // required for page drawing mode with u8g library
}

